## drivers/introspect_i3c/Kconfig
```kconfig
# Introspect configuration options

# Copyright (c) 2024 Microchip Technologies Inc.
# SPDX-License-Identifier: Apache-2.0

menuconfig INTROSPECT_I3C
	bool "I3C Introspect driver"
	help
	  Include Introspect drivers in system config.

if INTROSPECT_I3C

config INTROSPECT_I3C_INIT_PRIORITY
	int "Introspect I3C driver init priority"
	default 90
	help
	  Introspect I3C device driver initialization priority.
	  There isn't any critical component relying on this priority at
	  the moment.

module = INTROSPECT_I3C
module-str = introspect_i3c
#source "subsys/logging/Kconfig.template.log_config"

rsource "Kconfig.mec5"

endif # INTROSPECT_I3C
```

## drivers/introspect_i3c/Kconfig.mec5
```kconfig
# Introspect configuration options

# Copyright (c) 2024 Microchip Technologies Inc.
# SPDX-License-Identifier: Apache-2.0

config MICROCHIP_INTROSPECT_I3C
	bool "MEC5 Microchip Introspect I3C driver"
	default y
	help
	  Enable the Microchip Introspect I3C driver.
```

## dts/bindings/i3c/microchip,introspect_i3c.yaml
```yaml
# Copyright (c) 2024 Microchip Technology Inc.
# SPDX-License-Identifier: Apache-2.0

description: |
    Driver for Introspect I3C simulator to I3C bus

compatible: "microchip,introspect_i3c"

include: ["i3c-device.yaml"]
```

## west.yml
```yaml
# Copyright (c) 2024 Microchip Technology Inc.
# SPDX-License-Identifier: Apache-2.0

manifest:
  self:
    west-commands: scripts/west-commands.yml

  remotes:
    - name: origin
      url-base: https://github.com/MicrochipTech

  projects:
    - name: zephyr
      remote: origin
      # devel_mec5_all_updates commit on Nov 20 16:01:41
      revision: b500f961f5656dfd1373d55bc773306dcc6eeaaa
      import:
        # By using name-allowlist we can clone only the modules that are
        # strictly needed by the application.
        name-allowlist:
          - cmsis      # required by the ARM port
    - name: hal_microchip
      path: modules/hal/microchip
      remote: origin
      # tag: v0.3.2-pre1
      revision: aaa7811cb077c34f8a38a4d4103d6db7afd5e9f1
```
